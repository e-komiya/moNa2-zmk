## keyboards/microball/Kconfig
```kconfig
config MICROBALL_BEHAVIOR_DISCRETE_SCROLL
    bool "Enable Microball discrete scroll behavior"
    default y
```

## keyboards/microball/config/boards/shields/Test/Kconfig.defconfig
```kconfig
if SHIELD_MICROBALL_R

config ZMK_KEYBOARD_NAME
    default "microball_R"

config ZMK_SPLIT
    default y

config ZMK_SPLIT_ROLE_CENTRAL
    default y

endif

if SHIELD_MICROBALL_L

config ZMK_KEYBOARD_NAME
    default "microball_L"

config ZMK_SPLIT
    default y

endif
```

## keyboards/microball/config/boards/shields/Test/Kconfig.shield
```kconfig
config SHIELD_MICROBALL_R
    def_bool $(shields_list_contains,microball_R)

config SHIELD_MICROBALL_L
    def_bool $(shields_list_contains,microball_L)
```

## keyboards/microball/config/west.yml
```yaml
manifest:
  remotes:
    - name: zmkfirmware
      url-base: https://github.com/zmkfirmware
    - name: Yu1812
      url-base: https://github.com/Yu1812
  projects:
    - name: zmk
      remote: zmkfirmware
      revision: v0.2
      import: app/west.yml
    - name: zmk-pmw3610-driver
      remote: Yu1812
      revision: main
  self:
    path: config
```

## keyboards/microball/dts/bindings/behaviors/microball,behavior-discrete-scroll.yaml
```yaml
# Copyright (c) 2026
# SPDX-License-Identifier: MIT

description: Discrete wheel scroll behavior for encoder use

compatible: "microball,behavior-discrete-scroll"

properties:
  label:
    type: string
    required: false
    deprecated: true
  "#sensor-binding-cells":
    type: int
    required: true
    const: 0
  cw-delta:
    type: int
    default: -1
  ccw-delta:
    type: int
    default: 1
```
